## boards/shields/Archon_v2/Kconfig.defconfig
```kconfig
if SHIELD_ARCHON_v2

config ZMK_KEYBOARD_NAME
	default "Archon_v2"

endif # SHIELD_ARCHON_v2
```

## boards/shields/Archon_v2/Kconfig.shield
```kconfig
# No whitespace after the comma or in your keyboard name!
config SHIELD_ARCHON_V2
    def_bool $(shields_list_contains,Archon_v2)
```

## config/west.yml
```yaml
manifest:
  remotes:
    - name: zmkfirmware
      url-base: https://github.com/zmkfirmware
    - name: grime-e
      url-base: https://github.com/Grime-E
  projects:
    - name: zmk
      remote: zmkfirmware
      revision: v0.2
      import: app/west.yml
  self:
    path: config
```
